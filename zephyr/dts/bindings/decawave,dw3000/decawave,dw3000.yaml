## zephyr/dts/bindings/decawave,dw3000/decawave,dw3000.yaml
```yaml
description: Qorvo/Decawave DW3000 (SPI)

compatible: "decawave,dw3000"

include: spi-device.yaml

properties:
    reset-gpios:
      type: phandle-array
      required: true
      description: RESET pin (active low)

    irq-gpios:
      type: phandle-array
      required: true
      description: IRQ pin (active high)

    wakeup-gpios:
      type: phandle-array
      required: false
      description: WAKEUP pin (active high)

    spi-pol-gpios:
      type: phandle-array
      required: false
      description: SPI Polarity pin

    spi-pha-gpios:
      type: phandle-array
      required: false
      description: SPI Phase pin
```
